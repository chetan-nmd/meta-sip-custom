## conf/layer.conf
```bitbake
# We have a conf and classes directory, add to BBPATH
BBPATH .= ":${LAYERDIR}"

# We have recipes-* directories, add to BBFILES
BBFILES += "${LAYERDIR}/recipes-*/*/*.bb \
            ${LAYERDIR}/recipes-*/*/*.bbappend"

BBFILE_COLLECTIONS += "meta-sip-custom"
BBFILE_PATTERN_meta-sip-custom = "^${LAYERDIR}/"
BBFILE_PRIORITY_meta-sip-custom = "6"

LAYERDEPENDS_meta-sip-custom = "core"
LAYERSERIES_COMPAT_meta-sip-custom = "mickledore"
```
